## CMakeLists.txt
```
# SPDX-License-Identifier: Apache-2.0

cmake_minimum_required(VERSION 3.20.0)
list(APPEND SHIELD scd30)

find_package(Zephyr REQUIRED HINTS $ENV{ZEPHYR_BASE})
project(iotrees_calibration)

target_include_directories(app PRIVATE ${CMAKE_CURRENT_SOURCE_DIR}/src)

target_sources(app PRIVATE src/main.c
                    src/scd30/scd30_setup.c
                    src/ble/ble_setup.c)
```

## prj.conf
```kconfig
CONFIG_SENSOR=y
CONFIG_CBPRINTF_FP_SUPPORT=y

# Debug configurations
CONFIG_CALIBRATION_LOG_LEVEL_DBG=y
CONFIG_SENSOR_LOG_LEVEL_DBG=y
CONFIG_DEBUG_OPTIMIZATIONS=y

CONFIG_BT=y
CONFIG_BT_GATT_CLIENT=y
CONFIG_BT_BROADCASTER=y
CONFIG_BT_OBSERVER=y
#CONFIG_LOG=y

CONFIG_BT_ATT_PREPARE_COUNT=1
#CONFIG_BT_BAS=y
#CONFIG_BT_HRS=y
#CONFIG_BT_IAS=y
#CONFIG_BT_CTS=y
#CONFIG_BT_CTS_HELPER_API=y
CONFIG_BT_PERIPHERAL=y
#CONFIG_BT_DIS=y

CONFIG_BT_CTLR_TX_PWR_PLUS_8=y  # Max +8 dBm for nRF52832/nRF52840

CONFIG_BT_L2CAP_TX_MTU=251
CONFIG_BT_BUF_ACL_RX_SIZE=260
CONFIG_BT_BUF_ACL_TX_SIZE=260
CONFIG_BT_CTLR_DATA_LENGTH_MAX=251

CONFIG_BT_RX_STACK_SIZE=4096

# Defines name that will be used to advertise device
CONFIG_BT_DEVICE_NAME="Pulga iot calib 01"
# Appearance = Generic Industrial Measurement Device
#CONFIG_BT_DEVICE_APPEARANCE=5248

CONFIG_CALIBRATION_LOG_LEVEL_DBG=y
CONFIG_SENSOR_LOG_LEVEL_DBG=y
CONFIG_DEBUG_OPTIMIZATIONS=y
CONFIG_LOG_PROCESS_THREAD_SLEEP_MS=1
CONFIG_LOG_PROCESS_THREAD_STACK_SIZE=1024
CONFIG_LOG_BUFFER_SIZE=8192
```

## src/main.c
```c
#include <stdio.h>
#include <zephyr/logging/log.h>
#include <scd30/scd30_setup.h>
#include <ble/ble_setup.h>

#include <zephyr/bluetooth/bluetooth.h>
#include <zephyr/bluetooth/hci.h>
#include <zephyr/bluetooth/conn.h>
#include <zephyr/bluetooth/uuid.h>
#include <zephyr/bluetooth/gatt.h>
#include <zephyr/bluetooth/services/bas.h>

LOG_MODULE_REGISTER(main, CONFIG_CALIBRATION_LOG_LEVEL);

int main(void)
{
    int error;
	
    init_scd30();
    
    error = enable_scd30_low_power_mode();
	if (error)
	{
		LOG_DBG("Error enabling SCD30 low power mode: %d\n", error);
		return error;
	}

	error = bt_enable(NULL);

    if (error)
    {
        LOG_DBG("Bluetooth init failed (err %d)\n \r", error);
        return error;
    }

    bt_start_advertising();

    while (1)
    {
        k_sleep(K_MSEC(1000));
        bt_start_advertising(); //re-enable advertising after disconnect
    }
	return 0;
}
```
