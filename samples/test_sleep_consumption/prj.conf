## CMakeLists.txt
```
#-------------------------------------------------------------------------------
# Zephyr Example Application
#
# Copyright (c) 2021 Nordic Semiconductor ASA
# SPDX-License-Identifier: Apache-2.0

cmake_minimum_required(VERSION 3.13.1)

find_package(Zephyr REQUIRED HINTS $ENV{ZEPHYR_BASE})

project(app LANGUAGES C)

target_include_directories(app PRIVATE ${CMAKE_CURRENT_SOURCE_DIR}/src)

target_sources(app PRIVATE 
                    src/main.c)
```

## sample.yaml
```
# This file is provided so that the application can be compiled using Twister,
# the Zephyr testing tool. In this file, multiple combinations can be specified,
# so that you can easily test all of them locally or in CI.
sample:
  description: Generic Pulga Application
  name: generic-pulga-application 
common:
  build_only: true
  integration_platforms:
    - pulga
    - nucleo_f302r8
tests:
  app.default: {}
  app.debug:
    extra_overlay_confs:
      - debug.conf
```

## prj.conf
```kconfig
# Copyright (c) 2021 Nordic Semiconductor ASA
# SPDX-License-Identifier: Apache-2.0
#
# This file contains selected Kconfig options for the application.

CONFIG_SYSTEM_WORKQUEUE_STACK_SIZE=2048

# Activates the use of Zephyr's power management
CONFIG_CLOCK_CONTROL=y
#CONFIG_PM=y
CONFIG_PM_DEVICE=y
CONFIG_PM_DEVICE_RUNTIME=y
```

## src/main.c
```c
#include <zephyr/types.h>
#include <string.h>

#include <stdio.h>

#include <zephyr/kernel.h>
#include <zephyr/pm/device.h>
#include <zephyr/pm/device_runtime.h>

#define WAIT_PERIOD K_SECONDS(20)
int main(void)
{
	printf("Starting application");
	k_sleep(WAIT_PERIOD);

	uint32_t aux = 5;
	while (1)
	{
		printf("Starting sum");

		k_timepoint_t timeout = sys_timepoint_calc(WAIT_PERIOD);
		while (!sys_timepoint_expired(timeout))
		{
			aux += aux / 999;
			aux *= 19867 % 64546;
		}

		printf("Starting sleep");
		k_sleep(WAIT_PERIOD);

		printf("Starting busy wait");
		k_busy_wait(15/10 * WAIT_PERIOD.ticks / CONFIG_SYS_CLOCK_TICKS_PER_SEC * USEC_PER_SEC);

		printf("Starting sleep");
		k_sleep(WAIT_PERIOD);
	}

	k_sleep(K_FOREVER);
	return 0;
}
```
