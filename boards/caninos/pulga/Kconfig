## boards/caninos/pulga/Kconfig
```kconfig
if BOARD_PULGA

# Enable native bluetooth controller
config BT_CTLR
	default BT

endif # BOARD_PULGA
```

## boards/caninos/pulga/pulga_defconfig
```kconfig
# Activates Memory and Stack protection, increases their size
CONFIG_ARM_MPU=y
CONFIG_HW_STACK_PROTECTION=y
CONFIG_MAIN_STACK_SIZE=2048
CONFIG_HEAP_MEM_POOL_SIZE=8192
# Configures interfaces
CONFIG_GPIO=y
CONFIG_I2C=y
CONFIG_SERIAL=y
CONFIG_CONSOLE=y
# Activates UART support for console and async transmit buffer
CONFIG_UART_CONSOLE=y
CONFIG_UART_INTERRUPT_DRIVEN=y
CONFIG_UART_ASYNC_API=y
# Additional timer
CONFIG_NRFX_SYSTICK=y
# Activates logs and outputs them with UART
CONFIG_LOG=y
CONFIG_LOG_BACKEND_UART=y
CONFIG_LOG_PROCESS_THREAD_SLEEP_MS=500
# Activates thread monitoring and configuring their names and custom data
CONFIG_THREAD_MONITOR=y
CONFIG_THREAD_NAME=y
CONFIG_THREAD_RUNTIME_STATS=y
CONFIG_THREAD_CUSTOM_DATA=y
# Schedules the ready list of threads as a Red/Black tree, consuming 2kb of code
# Recommended for large number of threads
# Those threads are ready to be executed and are waiting for a CPU
CONFIG_SCHED_SCALABLE=y
# Implements wait queue as balanced tree, consuming 2kb of code
# Recommended for large number of threads
# Those threads are waiting for a specific resource
CONFIG_WAITQ_SCALABLE=y
# Enables sys_reboot API
CONFIG_REBOOT=y
```

## boards/shields/bme680/Kconfig.defconfig
```kconfig
# Copyright (c) 2024 LSI-TEC
# SPDX-License-Identifier: Apache-2.0

if SHIELD_BME680

config I2C
	default y
   
endif # SHIELD_BME680
```

## boards/shields/bme680/Kconfig.shield
```kconfig
# Copyright (c) 2023 LSI-TEC
# SPDX-License-Identifier: Apache-2.0

config SHIELD_BME680
	def_bool $(shields_list_contains,bme680)
```

## boards/shields/pulga-gps/Kconfig.shield
```kconfig
# Copyright (c) 2024 LSI-TEC
# SPDX-License-Identifier: Apache-2.0

# Activates SHIELD_PULGA_GPS config if pulga-gps is on shield list
config SHIELD_PULGA_GPS
	def_bool $(shields_list_contains,pulga-gps)
	select GNSS
```

## boards/shields/pulga-lora/Kconfig.shield
```kconfig
# Copyright (c) 2023 LSI-TEC
# SPDX-License-Identifier: Apache-2.0

config SHIELD_PULGA_LORA
	def_bool $(shields_list_contains,pulga-lora)
```

## boards/shields/pulga_gps/Kconfig.defconfig
```kconfig
# Copyright (c) 2024 LSI-TEC - Matheus de Almeida Orsi e Silva
# SPDX-License-Identifier: Apache-2.0

# Activates logging configurations
if SHIELD_PULGA_GPS

config PM_DEVICE
	default n

if APP_LOG_LEVEL_DBG

config GNSS_DUMP_TO_LOG
	default y

config GNSS_DUMP_TO_LOG_BUF_SIZE
	default 512
	
config GNSS_LOG_LEVEL_DBG
	bool

# Modem are HW and SW necessary for radio (RF) communication
config MODEM_MODULES_LOG_LEVEL_DBG
	bool

config MODEM_CHAT_LOG_BUFFER_SIZE
	default 512

endif #APP_LOG_LEVEL_DBG

endif # SHIELD_PULGA_GPS
```

## boards/shields/pulga_gps/Kconfig.shield
```kconfig
# Copyright (c) 2024 LSI-TEC - Matheus de Almeida Orsi e Silva
# SPDX-License-Identifier: Apache-2.0

# Activates SHIELD_PULGA_GPS config if pulga_gps is on shield list
config SHIELD_PULGA_GPS
	def_bool $(shields_list_contains,pulga_gps)
	select GNSS
	# Uncomment to activate data on connected satellites
	# select GNSS_SATELLITES
```

## boards/shields/pulga_lora/Kconfig.defconfig
```kconfig
# Copyright (c) 2024 LSI-TEC
# SPDX-License-Identifier: Apache-2.0

if SHIELD_PULGA_LORA

config SPI
	default y

config LORA
	default y

config LORA_SX127X
	default y

endif # SHIELD_PULGA_LORA
```

## boards/shields/pulga_vbatt/Kconfig.defconfig
```kconfig
# Copyright (c) 2024 LSI-TEC
# SPDX-License-Identifier: Apache-2.0

if SHIELD_PULGA_VBATT
	
config VBATT
	bool "Enable battery voltage measurement through the ADC"
	default y
	select ADC
	select SENSOR
	select GPIO
	depends on DT_HAS_VOLTAGE_DIVIDER_ENABLED

config LOW_BATT_THRESH
	int "Battery voltage threshold (in millivolts). Defines the low battery voltage"
	default 3400

config CRITICAL_BATT_THRESH
	int "Battery voltage threshold (in millivolts). Defines the critical low battery voltage"
	default 3300

endif # SHIELD_PULGA_VBATT
```

## boards/shields/pulga_vbatt/Kconfig.shield
```kconfig
# Copyright (c) 2023 LSI-TEC
# SPDX-License-Identifier: Apache-2.0

config SHIELD_PULGA_VBATT
	def_bool $(shields_list_contains,pulga_vbatt)
```

## boards/shields/scd30/Kconfig.defconfig
```kconfig
# Copyright (c) 2024 LSI-TEC
# SPDX-License-Identifier: Apache-2.0

if SHIELD_SCD30

config I2C
	default y

endif # SHIELD_SCD30
```

## boards/shields/scd30/Kconfig.shield
```kconfig
# Copyright (c) 2023 LSI-TEC
# SPDX-License-Identifier: Apache-2.0

config SHIELD_SCD30
	def_bool $(shields_list_contains,scd30)
```

## boards/shields/tcs34725/Kconfig.defconfig
```kconfig
# Copyright (c) 2025 LSI-TEC
# SPDX-License-Identifier: Apache-2.0

if SHIELD_TCS34725

config I2C
	default y
   
endif # SHIELD_TCS34725
```

## boards/shields/tcs34725/Kconfig.shield
```kconfig
# Copyright (c) 2023 LSI-TEC
# SPDX-License-Identifier: Apache-2.0

config SHIELD_TCS34725
	def_bool $(shields_list_contains,tcs34725)
```

## drivers/gnss/Kconfig
```kconfig
# Copyright (c) 2024 LSI-TEC - Matheus de Almeida Orsi e Silva
# SPDX-License-Identifier: Apache-2.0

if GNSS
rsource "Kconfig.quectel_l86"
endif
```

## drivers/sensor/Kconfig
```kconfig
# Copyright (c) 2021 Nordic Semiconductor ASA
# SPDX-License-Identifier: Apache-2.0

if SENSOR
rsource "si1133/Kconfig"
rsource "scd30/Kconfig"
endif # SENSOR
```

## drivers/sensor/scd30/Kconfig
```kconfig
# Sensirion SCD30 CO2 sensor configuration options

# Copyright (c) 2021 Advanced Climate Systems
# SPDX-License-Identifier: Apache-2.0

config SCD30
	bool "Sensirion SCD30 CO2 Sensor"
	select I2C
	default y
	select CRC
	depends on DT_HAS_SENSIRION_SCD30_ENABLED
	help
	  Enable driver for SCD30 CO2, temperature, and humidity sensor.
```

## drivers/sensor/si1133/Kconfig
```kconfig
# Si1133 UV Index and Ambient Light Sensor configuration options
# Copyright (c) 2024 Edgar Bernardi Righi
# SPDX-License-Identifier: Apache-2.0

config SI1133
	bool "Si1133 UV Index and Ambient Light Sensor"
	select I2C
	default y
	depends on DT_HAS_SILABS_SI1133_ENABLED
	help
	  Enable driver for Si1133 UV Index and Ambient Light Sensor.
```

## drivers/sensor/tcs34725/Kconfig
```kconfig
# AMS TCS34725 Color sensor configuration options

# Copyright (c) 2025 LSITEC - Kaue Rodrigues Barbosa
# SPDX-License-Identifier: Apache-2.0

config TCS34725
	bool "AMS TCS34725 Color Sensor"
	select I2C
	default y
	select CRC
	depends on DT_HAS_AMS_TCS34725_ENABLED
	help
	  Enable driver for TCS34725 color sensor
```

## dts/bindings/sensor/ams,tcs34725.yaml
```yaml
# Copyright (c) 2025 kauê Rodrigues Barbosa
# SPDX-License-Identifier: Apache-2.0

description: TCS34725 Color Sensor

compatible: "ams,tcs34725"

include: i2c-device.yaml
```

## dts/bindings/sensor/sensirion,scd30.yaml
```yaml
# Copyright (c) 2021 Murali Tejeshwar Janaswami
# SPDX-License-Identifier: Apache-2.0

description: SCD30 CO2, Humidity and Temperature sensor

compatible: "sensirion,scd30"

include: i2c-device.yaml

properties:    
    rdy-gpios:
      type: phandle-array
      required: false
      description: |
        GPIO connected to the SCD30 RDY pin, used to indicate data availability.
        This property defines the GPIO pin and configuration (active high/low).
```

## west.yml
```yaml
# Copyright (c) 2021 Nordic Semiconductor ASA
# SPDX-License-Identifier: Apache-2.0

manifest:

  remotes:
    - name: zephyrproject-rtos
      url-base: https://github.com/zephyrproject-rtos
    
    - name: caninos
      url-base: https://github.com/caninos-loucos

  projects:
    - name: zephyr
      remote: caninos
      revision: main
      import:
        # By using name-allowlist we can clone only the modules that are
        # strictly needed by the application.
        name-allowlist:
          - cmsis      # required by the ARM port
          - hal_nordic # required by the custom_plank board (Nordic based)
          
    - name: loramac-node
      remote: caninos
      revision: master
      path: modules/lib/loramac-node
```
