/*
 * Copyright (c) 2023 LSI-TEC
 *
 * SPDX-License-Identifier: Apache-2.0
 */

/ {
	vbatt {
		compatible = "voltage-divider";
		io-channels = <&adc 1>;
		full-ohms = <(2700 + 10000)>;
		output-ohms = <10000>;

		status = "okay";
	};
};

/*Battery Voltage ADC*/
&adc {
	status = "okay";

	#address-cells = <1>;
	#size-cells = <0>;

	/*Battery Voltage ADC channel*/
	channel@1 {
		reg = <1>;
		zephyr,gain = "ADC_GAIN_1_6";
		zephyr,reference = "ADC_REF_INTERNAL";
		zephyr,input-positive = <NRF_SAADC_AIN1>; /* P0.03 */
		zephyr,resolution = <14>;
		zephyr,oversampling = <8>;
		zephyr,acquisition-time = <ADC_ACQ_TIME(ADC_ACQ_TIME_MICROSECONDS, 40)>;
	};
};
